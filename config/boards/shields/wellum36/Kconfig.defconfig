## config/boards/shields/wellum36/Kconfig.defconfig
```kconfig
if SHIELD_WELLUM36_RIGHT

config ZMK_KEYBOARD_NAME
	default "Wellum"

config ZMK_SPLIT_BLE_ROLE_CENTRAL
	default y

config ZMK_USB
	default y

endif

if SHIELD_WELLUM36_LEFT || SHIELD_WELLUM36_RIGHT

config ZMK_SPLIT
	default y

config ZMK_BLE
	default y

endif
```

## config/boards/shields/wellum36/Kconfig.shield
```kconfig
config SHIELD_WELLUM36_LEFT
	def_bool $(shields_list_contains,wellum36_left)

config SHIELD_WELLUM36_RIGHT
	def_bool $(shields_list_contains,wellum36_right)
```

## firmware/zmk/wellum34/Kconfig.shield
```kconfig
config SHIELD_WELLUM34_LEFT
	def_bool $(shields_list_contains,wellum34_left)

config SHIELD_WELLUM34_RIGHT
	def_bool $(shields_list_contains,wellum34_right)
```
