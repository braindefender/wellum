#include "wellum36.dtsi"

/*
 * Вариант подключения: direct pin
 */

&default_transform {
	col-offset = <18>;
};

&kscan0 {
	input-gpios
		= <&pro_micro  2 (GPIO_ACTIVE_LOW | GPIO_PULL_UP)> // Y
		, <&pro_micro  4 (GPIO_ACTIVE_LOW | GPIO_PULL_UP)> // U
		, <&pro_micro  6 (GPIO_ACTIVE_LOW | GPIO_PULL_UP)> // I
		, <&pro_micro  8 (GPIO_ACTIVE_LOW | GPIO_PULL_UP)> // O
		, <&pro_micro  1 (GPIO_ACTIVE_LOW | GPIO_PULL_UP)> // P

		, <&pro_micro  3 (GPIO_ACTIVE_LOW | GPIO_PULL_UP)> // H
		, <&pro_micro  5 (GPIO_ACTIVE_LOW | GPIO_PULL_UP)> // J
		, <&pro_micro  7 (GPIO_ACTIVE_LOW | GPIO_PULL_UP)> // K
		, <&pro_micro  9 (GPIO_ACTIVE_LOW | GPIO_PULL_UP)> // L
		, <&pro_micro 21 (GPIO_ACTIVE_LOW | GPIO_PULL_UP)> // ~

		, <&pro_micro 15 (GPIO_ACTIVE_LOW | GPIO_PULL_UP)> // N
		, <&pro_micro 19 (GPIO_ACTIVE_LOW | GPIO_PULL_UP)> // M
		, <&pro_micro 10 (GPIO_ACTIVE_LOW | GPIO_PULL_UP)> // &
		, <&pro_micro 20 (GPIO_ACTIVE_LOW | GPIO_PULL_UP)> // [
		, <&pro_micro  0 (GPIO_ACTIVE_LOW | GPIO_PULL_UP)> // ]

		, <&pro_micro 18 (GPIO_ACTIVE_LOW | GPIO_PULL_UP)> // SYM
		, <&pro_micro 14 (GPIO_ACTIVE_LOW | GPIO_PULL_UP)> // SFT
		, <&pro_micro 16 (GPIO_ACTIVE_LOW | GPIO_PULL_UP)> // ALT
		;
};

/*
 * Вариант подключения: matrix
 */

&default_transform {
	col-offset = <5>;
};

&kscan0 {
  col-gpios
	  = <&pro_micro 14 GPIO_ACTIVE_HIGH>
	  , <&pro_micro 15 GPIO_ACTIVE_HIGH>
	  , <&pro_micro 18 GPIO_ACTIVE_HIGH>
	  , <&pro_micro 19 GPIO_ACTIVE_HIGH>
	  , <&pro_micro 20 GPIO_ACTIVE_HIGH>
		;
};
